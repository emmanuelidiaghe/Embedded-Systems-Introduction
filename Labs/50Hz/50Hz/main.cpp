/*
 * 50Hz.cpp
 *
 * Created: 24-Mar-20 2:49:43 PM
 * Author : Emancipator
 */ 
#define F_CPU 16000000
#define usingGeneralAVR
#define usingKeypad4X4
#define usingLCD
#define usingADC
#include <avr/io.h>
#include <string.h>
#include <avr/interrupt.h>

#define SD   PA7
#define LED  PC6
#define PWMA PD4
#define PWMB PD5
#define BUZZ PC7

#define keypadPort           PORTB
#define keypadPortDirection  DDRB

#define keypadRow0 PINB_B0
#define keypadRow1 PINB_B1
#define keypadRow2 PINB_B2
#define keypadRow3 PINB_B3
#define keypadCol0 PINB_B4
#define keypadCol1 PINB_B5
#define keypadCol2 PINB_B6
#define keypadCol3 PINB_B7


#define lcdRsDir DDRC_B0
#define lcdEnDir DDRC_B1
#define lcdD4Dir DDRC_B2
#define lcdD5Dir DDRC_B3
#define lcdD6Dir DDRC_B4
#define lcdD7Dir DDRC_B5

#define lcdRs PORTC_B0
#define lcdEn PORTC_B1
#define lcdD4 PORTC_B2
#define lcdD5 PORTC_B3
#define lcdD6 PORTC_B4
#define lcdD7 PORTC_B5

#include "C://Emancipator/Emancipator.h"
lcd display (16,2);

int x      = 0;
int OK     = 0;
int batt   = 0;
int output = 0;
int pointer= 0;
int PWMadd  = 50;
double outV  = 0;
double battV = 0;

int key;
char press;
char test[5] = "";
char user[5] = "2019";
char keyPadCode[17] = "123A456B789C*0#D";
uint8_t i = 0, j = 0, k = 0;
uint8_t access = 0;

float sinPWM[160] = {0,
	0.0196362378848791,	0.0392649036630707,	0.0588784281478357,	0.0784692479912056,	0.0980298086005533,
	0.117552567051788,	0.137029994998048,	0.15645458157278,	0.175818836286065,	0.195115291913097,
	0.214336507373689,	0.233475070601691,	0.252523601403226,	0.271474754302633,	0.290321221375019,
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	0.078063151120514,	0.05847178354463,	0.0388578681372417,	0.0192289683970647
};




int main(void)
{
	DDRD = (1<<DDD4)|(1<<DDD5); //PWM Pins
	DDRC = (1<<DDC6)|(1<<DDC7); //LED & Buzzer
	DDRA = (1<<DDA7); //SD; IR2110
	
	PORTD |=  (1<<PWMA);
	PORTD &= ~(1<<PWMB);
	PORTA  =  (1<<SD);
	PORTC  =  (1<<LED);
	PORTC &= ~(1<<BUZZ);
	
	//cli();//Disable Interrupts
	
	display.init();
	_delay_ms(100);
	display.clear();
	
	
	analogRefInit(VREFF_AVCC);
	_delay_ms(200);
	display.clear();
	
	TCCR1A = 0xA1;//0b10100001;
	TCCR1B = 0x01;//0b00000001;
	TCCR0  = 0x0A;//0b00001010;
	OCR0   = 123;

	TIMSK |=(1 << OCIE0);
	
	sei();//Enable Interrupt
	while (1)
	{
	}
}

ISR(TIMER0_COMP_vect)
{
	if(pointer>160 && OK==0){
		pointer=0;
		OK=1;
	}
	if(pointer>160 && OK==1){
		pointer=0;
		OK=0;
	}
	
	x=sinPWM[pointer]*PWMadd;
	pointer=pointer+1;
	
	if(OK==0){
		OCR1A = 0;
		OCR1B = x;
	}
	if(OK==1){
		OCR1B = 0;
		OCR1A = x;
	}
}


